# WB32FQ95 register map
Vendor: Westberry; File version: 0.1
Westberry WB32FQ95 (ARM Cortex-M3)
CPU: CM3 r2p1, little endian, MPU, no FPU, 4 interrupt priority bits
Registers are 32-bit, read-write, reset 0x0 unless marked. A register's access mark holds for its fields unless they carry their own. Offsets are from the block's base; lines under a group give offsets from that group; [hi:lo] are bit positions; {n}, {i} and the like mark numbered series; 'fields as' and 'values as' point back to an identical list; <NAME> marks a mode.

## Memory map
0x40000000 GPIOA size 0x400 — General-purpose I/O port A
0x40000400 GPIOB size 0x400 — General-purpose I/O port B
0x40000800 GPIOC size 0x400 — General-purpose I/O port C
0x40000C00 GPIOD size 0x400 — General-purpose I/O port D
0x40001C00 TIM1 size 0x400 — Advanced-control timer
0x40002000 TIM2 size 0x400 — General-purpose timer 2
0x40002400 TIM3 size 0x400 — General-purpose timer 3
0x40002800 TIM4 size 0x400 — General-purpose timer 4
0x40003000 QSPI size 0x400 — Quad serial peripheral interface
0x40003400 SPIS1 size 0x400 — Serial peripheral interface slave 1
0x40003800 UART1 size 0x400 — Universal asynchronous receiver/transmitter 1
0x40008000 UART2 size 0x400 — Universal asynchronous receiver/transmitter 2
0x40008400 UART3 size 0x400 — Universal asynchronous receiver/transmitter 3
0x40009000 SPIM2 size 0x400 — Serial peripheral interface master 2
0x40009400 SPIS2 size 0x400 — Serial peripheral interface slave 2
0x40010000 PWR size 0x400 — Power control. ANAKEY1/ANAKEY2 unlock write access to the ANCTL block.
0x40010400 ANCTL size 0x400 — Analog control block (holds HSE and PLL control). Write access is gated by PWR.ANAKEY1/ANAKEY2.
0x40010C00 RCC size 0x400 — Reset and clock control
0x40014C00 SFM size 0x400 — Special function macro. Also holds the USB PHY port control registers (USBPCON enables the USB transceiver).
0x40015400 CACHE size 0x400 — Flash cache control (holds the flash wait-state configuration)

## Interrupts
0 WWDG (RCC) — Window watchdog interrupt
1 PVD (RCC) — PVD through EXTI line detection interrupt
2 TAMPER (RCC) — Tamper interrupt
3 RTC (RCC) — RTC global interrupt
4 FMC (RCC) — FMC global interrupt
5 RCC — RCC global interrupt
6 EXTI0 (RCC) — EXTI line 0 interrupt
7 EXTI1 (RCC) — EXTI line 1 interrupt
8 EXTI2 (RCC) — EXTI line 2 interrupt
9 EXTI3 (RCC) — EXTI line 3 interrupt
10 EXTI4 (RCC) — EXTI line 4 interrupt
11 DMAC1 (RCC) — DMAC1 global interrupt
12 DMAC2 (RCC) — DMAC2 global interrupt
13 ADC (RCC) — ADC global interrupt
14 USB (RCC) — USB global interrupt
15 USB_DMA (RCC) — USB DMA interrupt
16 EXTI9_5 (RCC) — EXTI line[9:5] interrupts
17 TIM1_BRK (RCC) — TIM1 break interrupt
18 TIM1_UP (RCC) — TIM1 update interrupt
19 TIM1_TRG_COM (RCC) — TIM1 trigger and commutation interrupt
20 TIM1_CC (RCC) — TIM1 capture/compare interrupt
21 TIM2 (RCC) — TIM2 global interrupt
22 TIM3 (RCC) — TIM3 global interrupt
23 TIM4 (RCC) — TIM4 global interrupt
24 I2C1 (RCC) — I2C1 global interrupt
25 I2C2 (RCC) — I2C2 global interrupt
26 QSPI (RCC) — QSPI global interrupt
27 SPIM2 (RCC) — SPIM2 global interrupt
28 SPIS1 (RCC) — SPIS1 global interrupt
29 SPIS2 (RCC) — SPIS2 global interrupt
30 UART1 (RCC) — UART1 global interrupt
31 UART2 (RCC) — UART2 global interrupt
32 UART3 (RCC) — UART3 global interrupt
33 EXTI15_10 (RCC) — EXTI line[15:10] interrupts
34 RTCAlarm (RCC) — RTC alarm through EXTI line interrupt
35 USBP_WKUP (RCC) — USB pin wake-up global interrupt
36 I2S (RCC) — I2S global interrupt

## GPIOA — General-purpose I/O port A
Base 0x40000000
Same registers: GPIOB 0x40000400, GPIOC 0x40000800, GPIOD 0x40000C00
0x00 MODER — Port mode register
0x04 OTYPER — Port output type register
0x08 OSPEEDR — Port output speed register
0x0C PUPDR — Port pull-up/pull-down register
0x10 IDR ro — Port input data register
0x14 ODR — Port output data register
0x18 BSRR wo — Port bit set/reset register
0x1C LCKR — Port configuration lock register
0x20 AFRL — Alternate function low register
0x24 AFRH — Alternate function high register
0x28 SMIT — Port Schmitt-trigger input configuration register (vendor extension)
0x2C CURRENT — Port drive-current configuration register (vendor extension)
0x30 CFGMSK — Port per-pin configuration write-mask register (vendor extension)

## Notices in the file
SPDX-License-Identifier: GPL-2.0-or-later
