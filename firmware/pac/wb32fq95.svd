# WB32FQ95 register map
Vendor: Westberry; File version: 0.1
CPU: CM3 r2p1, little endian, MPU, no FPU, 4 interrupt priority bits
Registers are 32-bit, read-write, reset 0x0 unless marked. A register's access mark holds for its fields unless they carry their own. Offsets are from the block's base; [hi:lo] are bit positions; {n}, {i} and the like mark numbered series.

## PWR — Power control. ANAKEY1/ANAKEY2 unlock write access to the ANCTL block.
Base 0x40010000
0x00 CR0 — Control register 0
0x04 CR1 wo — Control register 1
0x08 CR2 — Control register 2
0x10 SR0 ro — Status register 0
0x14 SR1 ro — Status register 1
0x18 GPREG0 — General-purpose register 0
0x1C GPREG1 — General-purpose register 1
0x20 CFGR — Configuration register
0x28 ANAKEY1 wo — ANCTL write-enable key register 1
0x2C ANAKEY2 wo — ANCTL write-enable key register 2

## ANCTL — Analog control block (holds HSE and PLL control). Write access is gated by PWR.ANAKEY1/ANAKEY2.
Base 0x40010400
0x1C BGCR2 — Bandgap control register 2
0x2C MHSIENR — MHSI oscillator enable register
0x30 MHSISR — MHSI oscillator status register
0x38 FHSIENR — FHSI oscillator enable register
0x3C FHSISR — FHSI oscillator status register
0x44 LSIENR — LSI oscillator enable register
0x48 LSISR — LSI oscillator status register
0x4C HSECR0 — HSE control register 0
0x50 HSECR1 — HSE control register 1
0x58 HSESR — HSE status register
0x74 PLLCR — PLL control register
0x78 PLLENR — PLL enable register
0x7C PLLSR — PLL status register
0x80 PVDCR — Programmable voltage detector control register
0x84 PVDENR — Programmable voltage detector enable register
0x8C SARENR — SAR ADC enable register
0x90 USBPCR — USB PHY control register
0x94 PORCR — Power-on reset control register
0x98 CMPACR — Comparator A control register
0x9C CMPBCR — Comparator B control register
0xA0 ISR — Interrupt status register
0xA4 IER — Interrupt enable register
0xA8 ICR — Interrupt clear register
0xAC CMPASR — Comparator A status register
0xB0 CMPBSR — Comparator B status register
0xB4 DCSSENR — Clock security system enable register
0xB8 DCSSCR — Clock security system control register

## RCC — Reset and clock control
Base 0x40010C00
0x00 PLLPRE — PLL prescaler register
0x04 PLLSRC — PLL source register
0x08 MAINCLKSRC — Main clock source register
0x0C MAINCLKUEN — Main clock update enable register
0x14 USBPRE — USB prescaler register
0x18 AHBPRE — AHB prescaler register
0x1C APB1PRE — APB1 prescaler register
0x20 APB2PRE — APB2 prescaler register
0x24 MCLKPRE — MCLK prescaler register
0x28 I2SPRE — I2S prescaler register
0x2C MCLKSRC — MCLK source register
0x34 USBFIFOCLKSRC — USB FIFO clock source register
0x38 MCOSEL — Microcontroller clock output select register
{0x3C+4i} AHBENR{i} (i=0..2) — AHB peripheral clock enable register {i}
0x48 APB1ENR — APB1 peripheral clock enable register
0x4C APB2ENR — APB2 peripheral clock enable register
0x5C RNGCLKENR — RNG clock enable register
0x60 PCLKENR — Panel PCLK clock enable register
0x64 IWDGCLKENR — Independent watchdog clock enable register
0x6C USBCLKENR — USB clock enable register
0x70 I2SCLKENR — I2S SCLK enable register
0x74 SPIS1CLKENR — SPIS1 clock enable register
0x78 SPIS2CLKENR — SPIS2 clock enable register
0x7C USBFIFOCLKENR — USB FIFO clock enable register
0x88 AHBRSTR1 — AHB peripheral reset register 1
0x90 APB1RSTR — APB1 peripheral reset register
0x94 APB2RSTR — APB2 peripheral reset register
0xB8 I2SCLKRSTR — I2S SCLK reset register
0xC8 CLRRSTSTAT — Clear reset status register
0xD4 BDRSTR — Battery domain reset register
0xD8 LSI2RTCENR — LSI-to-RTC clock enable register
0xDC HSE2RTCENR — HSE-to-RTC clock enable register
0x100 RSTSTAT — Reset status register

## CACHE — Flash cache control (holds the flash wait-state configuration)
Base 0x40015400
0x00 CR — Cache control register

## SFM — Special function macro. Also holds the USB PHY port control registers (USBPCON enables the USB transceiver).
Base 0x40014C00
0x00 CTRL — Control register
0x04 DATA — Input data register
{0x8+4i} DOUT[{i}] (i=0..7) ro — Result register
0x40 USBPCON — USB port control register
0x44 USBPSDCSR — USB port state detect control/status register
0x48 USBPSTAT ro — USB port status register

## TIM1 — Advanced-control timer
Base 0x40001C00
Same registers: TIM2 0x40002000, TIM3 0x40002400, TIM4 0x40002800
0x00 CR1 — Control register 1
0x04 CR2 — Control register 2
0x08 SMCR — Slave mode control register
0x0C DIER — DMA/interrupt enable register
0x10 SR — Status register
0x14 EGR wo — Event generation register
0x18 CCMR1 — Capture/compare mode register 1
0x1C CCMR2 — Capture/compare mode register 2
0x20 CCER — Capture/compare enable register
0x24 CNT — Counter
0x28 PSC — Prescaler
0x2C ARR — Auto-reload register
0x30 RCR — Repetition counter register
{0x30+4i} CCR{i} (i=1..4) — Capture/compare register {i}
0x44 BDTR — Break and dead-time register

## SPIM2 — Serial peripheral interface master 2
Base 0x40009000
Same registers: QSPI 0x40003000, SPIS1 0x40003400, SPIS2 0x40009400
0x00 CR0 — Control register 0
0x04 CR1 — Control register 1
0x08 SPIENR — SPI enable register
0x0C MWCR — Microwire control register
0x10 SER — Slave enable register
0x14 BAUDR — Baud rate select
0x18 TXFTLR — Transmit FIFO threshold level
0x1C RXFTLR — Receive FIFO threshold level
0x20 TXFLR ro — Transmit FIFO level register
0x24 RXFLR ro — Receive FIFO level register
0x28 SR ro — Status register
0x2C IER — Interrupt enable register
0x30 ISR ro — Interrupt status register
0x34 RISR ro — Raw interrupt status register
0x38 TXOICR ro — Transmit FIFO overflow interrupt clear register
0x3C RXOICR ro — Receive FIFO overflow interrupt clear register
0x40 RXUICR ro — Receive FIFO underflow interrupt clear register
0x44 MSTICR ro — Multi-master interrupt clear register
0x48 ICR ro — Interrupt clear register
0x4C DMACR — DMA control register
0x50 DMATDLR — DMA transmit data level
0x54 DMARDLR — DMA receive data level
0x60 DR — Data register
0xF0 RX_SAMPLE_DLY — RX sample delay register
0xF4 ESPICR — Enhanced SPI control register

## UART3 — Universal asynchronous receiver/transmitter 3
Base 0x40008400
Same registers: UART1 0x40003800, UART2 0x40008000
0x00 RBR ro — Receive buffer register
0x00 THR wo (alternate view of RBR) — Transmit holding register
0x00 DLL (alternate view of RBR) — Divisor latch (low)
0x04 DLH — Divisor latch (high)
0x04 IER (alternate view of DLH) — Interrupt enable register
0x08 IIR ro — Interrupt identification register
0x08 FCR wo (alternate view of IIR) — FIFO control register
0x0C LCR — Line control register
0x10 MCR — Modem control register
0x14 LSR ro — Line status register
0x18 MSR ro — Modem status register
0x1C SCR — Scratchpad register
0x7C USR ro — UART status register
0x80 TFL ro — Transmit FIFO level
0x84 RFL ro — Receive FIFO level
0x88 SRR wo — Software reset register
0x8C SRTS — Shadow request to send
0x90 SBCR — Shadow break control register
0x98 SFE — Shadow FIFO enable
0x9C SRT — Shadow RCVR trigger
0xA0 STET — Shadow TX empty trigger
0xA4 HTX — Halt TX
0xA8 DMASA wo — DMA software acknowledge
0xC0 DLF — Divisor latch fractional value
0xC4 RAR — Receive address register
0xC8 TAR — Transmit address register
0xCC EXTLCR — Line extended control register
